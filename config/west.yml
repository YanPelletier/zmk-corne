## config/west.yml
```yaml
manifest:
  defaults:
    revision: main
  remotes:
    - name: zmkfirmware
      url-base: https://github.com/zmkfirmware
    - name: YanPelletier
      url-base: https://github.com/YanPelletier
    - name: snoyer
      url-base: https://github.com/snoyer/zmk-display-nice_view_sno1
  projects:
    - name: zmk
      remote: zmkfirmware
      import: app/west.yml
    - name: zmk-ecaps-word
      remote: YanPelletier
      revision: main
      path: modules/ecaps-word
    - name: nice-view-sno1
      remote: snoyer
      revision: main
      path: modules/nice-view-sno1
  self:
    path: config
```
